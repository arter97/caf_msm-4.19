## drivers/misc/qaic/Kconfig
```kconfig
# SPDX-License-Identifier: GPL-2.0-only
#
# QTI Cloud AI accelerators driver
#

config QAIC
	tristate "QTI Cloud AI accelerators"
	depends on PCI && HAS_IOMEM
	depends on MHI_BUS
	help
	  Enables driver for QTI's Cloud AI accelerator PCIe cards that are
	  designed to accelerate Deep Learning inference workloads.

	  The driver manages the PCIe devices and provides an IOCTL interface
	  for users to submit workloads to the devices.

	  If unsure, say N.

	  To compile this driver as a module, choose M here: the
	  module will be called qaic.

config QAIC_HWMON
	bool "Qualcomm Cloud AI 100 accelerator telemetry"
	depends on QAIC
	depends on HWMON
	help
	  Enables telemetry via the HWMON interface for Qualcomm's Cloud AI
	  100 accelerator PCIe cards.

	  If unsure, say N.
```

## drivers/net/can/spi/Kconfig
```kconfig
menu "CAN SPI interfaces"
	depends on SPI

config CAN_HI311X
	tristate "Holt HI311x SPI CAN controllers"
	depends on CAN_DEV && SPI && HAS_DMA
	---help---
	  Driver for the Holt HI311x SPI CAN controllers.

config CAN_MCP251X
	tristate "Microchip MCP251x and MCP25625 SPI CAN controllers"
	depends on HAS_DMA
	---help---
	  Driver for the Microchip MCP251x and MCP25625 SPI CAN
	  controllers.

config CAN_TCAN4X5X
	tristate "Texas Instruments TCAN4X5X SPI CAN controllers"
	depends on HAS_DMA
	---help---
	  Driver for the Texas Instruments TCAN4X5X SPI CAN controllers.
config CAN_DBG_TCAN4X5X
	tristate "Texas Instruments TCAN4X5X SPI CAN controllers"
	depends on HAS_DMA
	---help---
	  Driver for the Texas Instruments TCAN4X5X SPI CAN controllers.
endmenu
```
